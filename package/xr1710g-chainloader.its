## package/xr1710g-chainloader.its
```
/dts-v1/;

/ {
	description = "XR1710G stock-bootm compatible chainloader FIT";
	#address-cells = <1>;

	images {
		fdt@1 {
			description = "XR1710G chainloader control DTB";
			data = /incbin/("chainloader-control.dtb");
			type = "flat_dt";
			arch = "arm64";
			compression = "none";
			hash@1 { algo = "sha1"; };
		};

		kernel@1 {
			description = "XR1710G chainloader shim";
			data = /incbin/("chainloader-shim.bin");
			type = "kernel";
			arch = "arm64";
			os = "linux";
			compression = "none";
			load = <0x80088000>;
			entry = <0x80088000>;
			hash@1 { algo = "sha1"; };
		};

		uboot@1 {
			description = "XR1710G second-stage U-Boot payload";
			data = /incbin/("u-boot.bin");
			type = "firmware";
			arch = "arm64";
			compression = "none";
			load = <0x81e00000>;
			entry = <0x81e00000>;
			hash@1 { algo = "sha1"; };
		};
	};

	configurations {
		default = "conf@1";
		conf@1 {
			description = "Boot chainloader shim with embedded secondary U-Boot";
			kernel = "kernel@1";
			fdt = "fdt@1";
			loadables = "uboot@1";
		};
	};
};
```
